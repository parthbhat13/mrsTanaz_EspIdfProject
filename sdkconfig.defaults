## sdkconfig.defaults
```kconfig
#
# ESP32 Specific 
#
CONFIG_ESPTOOLPY_FLASHSIZE="4MB"
CONFIG_ESP32_DEFAULT_CPU_FREQ_240=y
CONFIG_ESP32_DEFAULT_CPU_FREQ_MHZ=240


#
# Gsm Configuration
#
CONFIG_EXAMPLE_MODEM_PPP_APN="internet"
CONFIG_EXAMPLE_MODEM_PPP_AUTH_NONE=y
```
